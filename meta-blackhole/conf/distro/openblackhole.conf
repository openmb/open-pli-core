## meta-blackhole/conf/distro/openblackhole.conf
```bitbake
#@TYPE: Distribution
#@NAME: Open Black Hole
#@DESCRIPTION: Embedded Linux Distribution Configuration for STB's

DISTRO = "openblackhole"
DISTRO_NAME ?= "openblackhole"
BHDISTRO_VERSION = "0.4"
DISTRO_VERSION = "0.4"
IMAGE_VERSION = "4"
DISTRO_TYPE ?= "release"
BUILD_VERSION = "4"

FEED_NAME ?= "${DISTRO_NAME}/${IMAGE_VERSION}"
DISTRO_FEED_URI ?= "http://openmb.net/feeds/${FEED_NAME}"
DISTRO_FEED_PREFIX ?= "${DISTRO_NAME}"

IMAGE_NAME = "OpenBlackHole-${BHDISTRO_VERSION}-${MACHINE}"
```

## meta-broadmedia/conf/machine/mbtwinplus.conf
```bitbake
#@TYPE: Machine
#@NAME: Miraclebox
#@DESCRIPTION: Machine configuration for the Miraclebox Premium Twin Plus

require conf/machine/include/broadmedia-oem.inc

PREFERRED_VERSION_linux-broadmedia = "4.1.15"
PREFERRED_VERSION_linux-libc-headers = "4.1"

MACHINE_ESSENTIAL_EXTRA_RDEPENDS = "\
    broadmedia-dvb-modules-twinplus \
    "

CHIPSET = "bcm7241"

UBI_VOLNAME = "rootfs"
MKUBIFS_ARGS = "-m 2048 -e 126976 -c 8192"
UBINIZE_ARGS = "-m 2048 -p 128KiB"

MACHINE_BRAND = "Miraclebox"

MACHINE_NAME = "Premium Twin Plus"

MACHINEBUILD = "mbtwinplus"

IMAGEDIR ?= "miraclebox/twinplus"

MACHINE_FEATURES += "dvb-c ci textlcd videoenhancement wlan kernelwifi extrakernelwifi"

MACHINE_EXTRA_RDEPENDS += "enigma2-plugin-extensions-hbbtv-miraclebox"

MACHINE_KERNEL_PR = "r2"
```

## meta-ceryon/conf/machine/include/ceryon-oem.inc
```bitbake
# We know about rtc
include conf/machine/include/build-extras.inc

BRAND_OEM = "ceryon"

MTD_KERNEL = "mtd1"
MTD_ROOTFS = "mtd2"
KERNEL_FILE = "kernel.bin"
ROOTFS_FILE = "rootfs.bin"

DVBPROVIDER = "kernel"

MACHINE_ESSENTIAL_EXTRA_RRECOMMENDS = "\
    kernel-module-cdfs \
    "

MACHINE_EXTRA_RRECOMMENDS = " \
    ceryon-shutdown \
    gst-plugin-dvbmediasink \
    "

include conf/machine/include/autoload-filesystems.inc

DVBMEDIASINK_CONFIG = "--with-wma --with-wmv --with-pcm --with-dts --with-eac3"

TARGET_ARCH = "mipsel"
DEFAULTTUNE = "mips32el"

PREFERRED_PROVIDER_virtual/kernel = "linux-ceryon"

PREFERRED_VERSION_linux-ceryon = "4.0.1"
PREFERRED_VERSION_linux-libc-headers = "4.0"

KERNEL_IMAGETYPE = "vmlinux"
KERNEL_OUTPUT = "${KERNEL_IMAGETYPE}"
KERNEL_CONSOLE = "ttyS0,115200n8"

IMAGE_FSTYPES ?= "ubi"

IMAGE_CMD_ubi_prepend = " \
    rm -rf ${IMAGE_ROOTFS}/boot/*; \
    rm -rf ${IMAGE_ROOTFS}/tmp/*; \
    "

MACHINE_FEATURES += "3dtv alsa hdmicec switchoff bootsplash omb \
    ${@base_contains('MACHINEBUILD', 'nanoc', 'dvbc-only' , '', d)} \
    "

BOOTLOGO_FILENAME = "splash.bin"

require conf/machine/include/tune-mips32.inc
```

## meta-ceryon/conf/machine/mbmicro.conf
```bitbake
#@TYPE: Machine
#@NAME: Miraclebox
#@DESCRIPTION: Machine configuration for the Miraclebox Premium Micro

require conf/machine/include/ceryon-oem.inc

CHIPSET = "bcm7362"

MACHINE_BRAND = "Miraclebox"

MACHINE_NAME = "Premium Micro"

MACHINEBUILD = "mbmicro"

IMAGEDIR ?= "miraclebox/micro"

MACHINE_ESSENTIAL_EXTRA_RDEPENDS = "\
    ceryon-dvb-modules-7000s \
    "

MACHINE_FEATURES += "videoenhancement wlan kernelwifi extrakernelwifi osdposition hdmicec 3dtv"

UBI_VOLNAME = "rootfs"
MKUBIFS_ARGS = "-m 2048 -e 126976 -c 4096"
UBINIZE_ARGS = "-m 2048 -p 128KiB"

IMAGE_CMD_ubi_append = " \
    mkdir -p ${DEPLOY_DIR_IMAGE}/${IMAGEDIR}; \
    cp ${DEPLOY_DIR_IMAGE}/splash.bin ${DEPLOY_DIR_IMAGE}/${IMAGEDIR}/splash.bin; \
    mv ${DEPLOY_DIR_IMAGE}/${IMAGE_NAME}.rootfs.ubi ${DEPLOY_DIR_IMAGE}/${IMAGEDIR}/${ROOTFS_FILE}; \
    gzip -9c ${DEPLOY_DIR_IMAGE}/vmlinux-${MACHINE}.bin > ${DEPLOY_DIR_IMAGE}/${IMAGEDIR}/${KERNEL_FILE}; \
    echo ${DISTRO_NAME}-${IMAGE_VERSION}-${MACHINE}-${DATE}_usb > ${DEPLOY_DIR_IMAGE}/${IMAGEDIR}/imageversion; \
    echo "rename this file to 'force' to force an update without confirmation" > ${DEPLOY_DIR_IMAGE}/${IMAGEDIR}/noforce; \
    cd ${DEPLOY_DIR_IMAGE}; \
    zip ${DISTRO_NAME}-${DISTRO_VERSION}-${MACHINE}-${DATE}_usb.zip ${IMAGEDIR}/*; \
    rm -f ${DEPLOY_DIR_IMAGE}/*.ubifs; \
    rm -f ${DEPLOY_DIR_IMAGE}/*.manifest; \
    rm -f ${DEPLOY_DIR_IMAGE}/.ubifs; \
    rm -f ${DEPLOY_DIR_IMAGE}/.manifest; \
    rm -Rf ${IMAGEDIR}; \
    "
```

## meta-ini/conf/machine/include/miraclebox.inc
```bitbake
# We know about rtc
MACHINE_FEATURES_BACKFILL_CONSIDERED = "rtc"

BRAND_OEM = "ini"

DVBPROVIDER = "kernel"

MACHINE_ESSENTIAL_EXTRA_RRECOMMENDS = "\
	kernel-module-cdfs \
	"

MACHINE_EXTRA_RRECOMMENDS = " \
	gst-plugin-dvbmediasink \
	"

include conf/machine/include/autoload-filesystems.inc

DVBMEDIASINK_CONFIG = "--with-pcm"

TARGET_ARCH = "mipsel"
DEFAULTTUNE ?= "mips32el"

GLIBC_EXTRA_OECONF = "--with-tls --with-__thread"

KERNEL_IMAGETYPE = "vmlinux"
KERNEL_OUTPUT = "${KERNEL_IMAGETYPE}"
KERNEL_CONSOLE = "ttyS0,115200n8"

IMAGE_FSTYPES ?= "ubi"

IMAGE_CMD_ubi_prepend = " \
	rm -rf ${IMAGE_ROOTFS}/boot/*; \
	rm -rf ${IMAGE_ROOTFS}/tmp/*; \
	"

MACHINE_FEATURES += "3dtv alsa hdmicec switchoff wifi 3dtvpli bootsplash kernelwifi"

BOOTLOGO_FILENAME = "splash.bin"

PREFERRED_PROVIDER_virtual/blindscan-dvbc = "ini-blindscan-utils"
PREFERRED_PROVIDER_virtual/blindscan-dvbs = "ini-blindscan-utils"

require conf/machine/include/tune-mips32.inc
```

## meta-ini/conf/machine/mbmini.conf
```bitbake
#@TYPE: Machine
#@NAME: Miraclebox
#@DESCRIPTION: Machine configuration for the Miraclebox Premium Mini

require conf/machine/include/miraclebox.inc

MACHINE_BRAND = "Miraclebox"

MACHINE_NAME = "Premium Mini"

MACHINEBUILD = "mbmini"

MACHINE_OEM = "inihde"

MACHINE_ESSENTIAL_EXTRA_RDEPENDS = "\
	ini-dvb-modules-inihde \
	"
	
PREFERRED_PROVIDER_virtual/kernel = "linux-ini-hde"
PREFERRED_VERSION_linux-${MACHINE} = "3.12.1"
PREFERRED_VERSION_linux-libc-headers = "3.3"

MACHINE_FEATURES += " wlan kernelwifi extrakernelwifi osdposition hdmicec 3dtv textlcd ci dvb-c blindscan-dvbc blindscan-dvbs"

CHIPSET = "bcm7358"

DEFAULTTUNE = "mips32el-nf"

MACHINE_KERNEL_PR = "r4"

IMAGEDIR ?= "miraclebox/mini"

UBI_VOLNAME = "rootfs"
MKUBIFS_ARGS = "-m 2048 -e 126976 -c 4096"
UBINIZE_ARGS = "-m 2048 -p 128KiB"

IMAGE_CMD_ubi_append = " \
	mkdir -p ${DEPLOY_DIR_IMAGE}/${IMAGEDIR}; \
	mv ${DEPLOY_DIR_IMAGE}/${IMAGE_NAME}.rootfs.ubi ${DEPLOY_DIR_IMAGE}/${IMAGEDIR}/rootfs.bin; \
	gzip -f -9c ${DEPLOY_DIR_IMAGE}/vmlinux-${MACHINE}.bin > ${DEPLOY_DIR_IMAGE}/${IMAGEDIR}/kernel.bin; \
	echo ${DISTRO_NAME}-${IMAGE_VERSION}-${MACHINE}-${DATE}_usb > ${DEPLOY_DIR_IMAGE}/${IMAGEDIR}/imageversion; \
	echo "rename this file to 'force' to force an update without confirmation" > ${DEPLOY_DIR_IMAGE}/${IMAGEDIR}/noforce; \
	cp ${DEPLOY_DIR_IMAGE}/splash.bin ${DEPLOY_DIR_IMAGE}/${IMAGEDIR}/splash.bin; \
	cd ${DEPLOY_DIR_IMAGE}; \
	zip ${DISTRO_NAME}-${DISTRO_VERSION}-${MACHINE}-${DATE}_usb.zip ${IMAGEDIR}/*; \
	rm -rf miraclebox; \
	"
	
```

## meta-ini/conf/machine/mbminiplus.conf
```bitbake
#@TYPE: Machine
#@NAME: Miraclebox
#@DESCRIPTION: Machine configuration for the Miraclebox Premium Mini Plus

require conf/machine/include/miraclebox.inc

MACHINE_BRAND = "Miraclebox"

MACHINE_NAME = "Premium Mini PLUS"

MACHINEBUILD = "mbminiplus"

MACHINE_OEM = "inihde2" 

MACHINE_ESSENTIAL_EXTRA_RDEPENDS = "\
	ini-dvb-modules-inihde2 \
	"
	
PREFERRED_PROVIDER_virtual/kernel = "linux-ini-hde2"
PREFERRED_VERSION_linux-${MACHINE} = "3.14.2"
PREFERRED_VERSION_linux-libc-headers = "3.13"

MACHINE_FEATURES += " wlan kernelwifi extrakernelwifi osdposition hdmicec 3dtv textlcd ci dvb-c blindscan-dvbc blindscan-dvbs"

CHIPSET = "bcm7362"

TARGET_FPU = "hard"

MACHINE_KERNEL_PR = "r5"

IMAGEDIR ?= "miraclebox/miniplus"

UBI_VOLNAME = "rootfs"
MKUBIFS_ARGS = "-m 2048 -e 126976 -c 4096"
UBINIZE_ARGS = "-m 2048 -p 128KiB"

IMAGE_CMD_ubi_append = " \
	mkdir -p ${DEPLOY_DIR_IMAGE}/${IMAGEDIR}; \
	cp ${DEPLOY_DIR_IMAGE}/${IMAGE_NAME}.rootfs.ubi ${DEPLOY_DIR_IMAGE}/${IMAGEDIR}/rootfs.bin; \
	gzip -f -9c ${DEPLOY_DIR_IMAGE}/vmlinux-${MACHINE}.bin > ${DEPLOY_DIR_IMAGE}/${IMAGEDIR}/kernel.bin; \
	echo ${DISTRO_NAME}-${IMAGE_VERSION}-${MACHINE}-${DATE}_usb > ${DEPLOY_DIR_IMAGE}/${IMAGEDIR}/imageversion; \
	echo "rename this file to 'force' to force an update without confirmation" > ${DEPLOY_DIR_IMAGE}/${IMAGEDIR}/noforce; \
	cp ${DEPLOY_DIR_IMAGE}/splash.bin ${DEPLOY_DIR_IMAGE}/${IMAGEDIR}/splash.bin; \
	cp ${DEPLOY_DIR_IMAGE}/cfe.bmp ${DEPLOY_DIR_IMAGE}/${IMAGEDIR}/; \
	cp ${DEPLOY_DIR_IMAGE}/splash.bmp ${DEPLOY_DIR_IMAGE}/${IMAGEDIR}/; \
	cp ${DEPLOY_DIR_IMAGE}/imageversion.bmp ${DEPLOY_DIR_IMAGE}/${IMAGEDIR}/; \
	cp ${DEPLOY_DIR_IMAGE}/kernel.bmp ${DEPLOY_DIR_IMAGE}/${IMAGEDIR}/; \
	cp ${DEPLOY_DIR_IMAGE}/rootfs.bmp ${DEPLOY_DIR_IMAGE}/${IMAGEDIR}/; \
	cp ${DEPLOY_DIR_IMAGE}/finished.bmp ${DEPLOY_DIR_IMAGE}/${IMAGEDIR}/; \
	cd ${DEPLOY_DIR_IMAGE}; \
	zip ${DISTRO_NAME}-${DISTRO_VERSION}-${MACHINE}-${DATE}_usb.zip ${IMAGEDIR}/*; \
	rm -rf miraclebox; \
	mkdir -p ${DEPLOY_DIR_IMAGE}/miraclebox/minihybrid; \
	mv ${DEPLOY_DIR_IMAGE}/${IMAGE_NAME}.rootfs.ubi ${DEPLOY_DIR_IMAGE}/miraclebox/minihybrid/rootfs.bin; \
	gzip -f -9c ${DEPLOY_DIR_IMAGE}/vmlinux-${MACHINE}.bin > ${DEPLOY_DIR_IMAGE}/miraclebox/minihybrid/kernel.bin; \
	echo ${DISTRO_NAME}-${IMAGE_VERSION}-${MACHINE}-${DATE}_usb > ${DEPLOY_DIR_IMAGE}/miraclebox/minihybrid/imageversion; \
	echo "rename this file to 'force' to force an update without confirmation" > ${DEPLOY_DIR_IMAGE}/miraclebox/minihybrid/noforce; \
	cp ${DEPLOY_DIR_IMAGE}/splash.bin ${DEPLOY_DIR_IMAGE}/miraclebox/minihybrid/splash.bin; \
	cp ${DEPLOY_DIR_IMAGE}/cfe.bmp ${DEPLOY_DIR_IMAGE}/miraclebox/minihybrid/; \ 
	cp ${DEPLOY_DIR_IMAGE}/splash.bmp ${DEPLOY_DIR_IMAGE}/miraclebox/minihybrid/; \
	cp ${DEPLOY_DIR_IMAGE}/imageversion.bmp ${DEPLOY_DIR_IMAGE}/miraclebox/minihybrid/; \
	cp ${DEPLOY_DIR_IMAGE}/kernel.bmp ${DEPLOY_DIR_IMAGE}/miraclebox/minihybrid/; \
	cp ${DEPLOY_DIR_IMAGE}/rootfs.bmp ${DEPLOY_DIR_IMAGE}/miraclebox/minihybrid/; \
	cp ${DEPLOY_DIR_IMAGE}/finished.bmp ${DEPLOY_DIR_IMAGE}/miraclebox/minihybrid/; \
	cd ${DEPLOY_DIR_IMAGE}; \
	zip ${DISTRO_NAME}-${DISTRO_VERSION}-mbhybrid-${DATE}_usb.zip miraclebox/minihybrid/*; \
	rm -rf miraclebox; \
	"
	
```

## meta-ini/conf/machine/mbtwin.conf
```bitbake
#@TYPE: Machine
#@NAME: Miraclebox
#@DESCRIPTION: Machine configuration for the Miraclebox Premium Twin

require conf/machine/include/miraclebox.inc

MACHINE_BRAND = "Miraclebox"

MACHINE_NAME = "Premium Twin"

MACHINEBUILD = "mbtwin"

MACHINE_OEM = "inihdx" 

MACHINE_ESSENTIAL_EXTRA_RDEPENDS = "\
	ini-dvb-modules-inihdx \
	"
	
PREFERRED_PROVIDER_virtual/kernel = "linux-ini-hdx"
PREFERRED_VERSION_linux-${MACHINE} = "3.6.0"
PREFERRED_VERSION_linux-libc-headers = "3.6"

MACHINE_FEATURES += "externalwifi wlan osdposition hdmicec 3dtv fan textlcd fanctrl ci dvb-c blindscan-dvbc blindscan-dvbs"

CHIPSET = "bcm7413"

TARGET_FPU = "hard"

MACHINE_KERNEL_PR = "r3"

IMAGEDIR ?= "miraclebox/twin"

UBI_VOLNAME = "rootfs"
MKUBIFS_ARGS = "-m 2048 -e 126976 -c 4096"
UBINIZE_ARGS = "-m 2048 -p 128KiB"

IMAGE_CMD_ubi_append = " \
	mkdir -p ${DEPLOY_DIR_IMAGE}/${IMAGEDIR}; \
	mv ${DEPLOY_DIR_IMAGE}/${IMAGE_NAME}.rootfs.ubi ${DEPLOY_DIR_IMAGE}/${IMAGEDIR}/rootfs.bin; \
	gzip -f -9c ${DEPLOY_DIR_IMAGE}/vmlinux-${MACHINE}.bin > ${DEPLOY_DIR_IMAGE}/${IMAGEDIR}/kernel.bin; \
	echo ${DISTRO_NAME}-${IMAGE_VERSION}-${MACHINE}-${DATE}_usb > ${DEPLOY_DIR_IMAGE}/${IMAGEDIR}/imageversion; \
	echo "rename this file to 'force' to force an update without confirmation" > ${DEPLOY_DIR_IMAGE}/${IMAGEDIR}/noforce; \
	cp ${DEPLOY_DIR_IMAGE}/splash.bin ${DEPLOY_DIR_IMAGE}/${IMAGEDIR}/splash.bin; \
	cd ${DEPLOY_DIR_IMAGE}; \
	zip ${DISTRO_NAME}-${DISTRO_VERSION}-${MACHINE}-${DATE}_usb.zip ${IMAGEDIR}/*; \
	rm -rf miraclebox; \
	"
	
```

## meta-ini/conf/machine/mbultra.conf
```bitbake
#@TYPE: Machine
#@NAME: Miraclebox
#@DESCRIPTION: Machine configuration for the Miraclebox Premium Ultra

require conf/machine/include/miraclebox.inc

MACHINE_BRAND = "Miraclebox"

MACHINE_NAME = "Premium Ultra"

MACHINEBUILD = "mbultra"

MACHINE_OEM = "inihdp" 

MACHINE_ESSENTIAL_EXTRA_RDEPENDS = "\
	ini-dvb-modules-inihdp \
	"
PREFERRED_PROVIDER_virtual/kernel = "linux-ini-hdp"
PREFERRED_VERSION_linux-ini-hdp = "3.14.2"
PREFERRED_VERSION_linux-libc-headers = "3.13"

MACHINE_FEATURES += "wlan osdposition hdmicec 3dtv fan fanctrl ci dvb-c blindscan-dvbc blindscan-dvbs colorlcd kernelrt2800 iniwol"

CHIPSET = "bcm7425"

MACHINE_KERNEL_PR = "r0"

IMAGEDIR ?= "miraclebox/ultra"

UBI_VOLNAME = "rootfs"
MKUBIFS_ARGS = "-m 4096 -e 1040384 -c 1984"
UBINIZE_ARGS = "-m 4096 -p 1024KiB"


MACHINE_EXTRA_RDEPENDS = "\
    \
    ini-coldboot \
    ini-ethwol \
    \
    rt8723bt kernel-module-rtk-btusb \  
    \
    rt8723a kernel-module-8723au \
    \
    rt3070 firmware-rt2870 \
    "

IMAGE_CMD_ubi_append = " \
	mkdir -p ${DEPLOY_DIR_IMAGE}/${IMAGEDIR}; \
	mv ${DEPLOY_DIR_IMAGE}/${IMAGE_NAME}.rootfs.ubi ${DEPLOY_DIR_IMAGE}/${IMAGEDIR}/rootfs.bin; \
	gzip -f -9c ${DEPLOY_DIR_IMAGE}/vmlinux-${MACHINE}.bin > ${DEPLOY_DIR_IMAGE}/${IMAGEDIR}/kernel.bin; \
	echo ${DISTRO_NAME}-${IMAGE_VERSION}-${MACHINE}-${DATE}_usb > ${DEPLOY_DIR_IMAGE}/${IMAGEDIR}/imageversion; \
	echo "rename this file to 'force' to force an update without confirmation" > ${DEPLOY_DIR_IMAGE}/${IMAGEDIR}/noforce; \
	cp ${DEPLOY_DIR_IMAGE}/splash.bin ${DEPLOY_DIR_IMAGE}/${IMAGEDIR}/splash.bin; \
	cp ${DEPLOY_DIR_IMAGE}/cfe.bmp ${DEPLOY_DIR_IMAGE}/${IMAGEDIR}/cfe.bmp; \
	cp ${DEPLOY_DIR_IMAGE}/splash.bmp ${DEPLOY_DIR_IMAGE}/${IMAGEDIR}/splash.bmp; \
	cp ${DEPLOY_DIR_IMAGE}/imageversion.bmp ${DEPLOY_DIR_IMAGE}/${IMAGEDIR}/imageversion.bmp; \
	cp ${DEPLOY_DIR_IMAGE}/kernel.bmp ${DEPLOY_DIR_IMAGE}/${IMAGEDIR}/kernel.bmp; \
	cp ${DEPLOY_DIR_IMAGE}/rootfs.bmp ${DEPLOY_DIR_IMAGE}/${IMAGEDIR}/rootfs.bmp; \
	cp ${DEPLOY_DIR_IMAGE}/finished.bmp ${DEPLOY_DIR_IMAGE}/${IMAGEDIR}/finished.bmp; \
	cd ${DEPLOY_DIR_IMAGE}; \
	zip ${DISTRO_NAME}-${DISTRO_VERSION}-${MACHINE}-${DATE}_usb.zip ${IMAGEDIR}/*; \
	rm -rf miraclebox; \
	"
	
```

## meta-openpli/conf/machine/mbmini.conf
```bitbake
#@TYPE: Machine
#@NAME: Miraclebox
#@DESCRIPTION: Machine configuration for the Miraclebox Premium Mini

require conf/machine/include/miraclebox.inc

MACHINE_BRAND = "Miraclebox"

MACHINE_NAME = "Premium Mini"

MACHINE_ESSENTIAL_EXTRA_RDEPENDS = "\
	ini-dvb-modules-inihde \
	"
	
PREFERRED_VERSION_linux-${MACHINE} = "3.6.0"
PREFERRED_VERSION_linux-libc-headers = "3.6"

MACHINE_FEATURES += "textlcd ci blindscan-dvbs dvb-c blindscan-dvbc"

CHIPSET = "bcm7358"

TARGET_FPU = "soft"

MACHINE_KERNEL_PR = "r4"

IMAGEDIR ?= "miraclebox/mini"

UBI_VOLNAME = "rootfs"
MKUBIFS_ARGS = "-m 2048 -e 126976 -c 4096"
UBINIZE_ARGS = "-m 2048 -p 128KiB"

IMAGE_CMD_ubi_append = " \
	mkdir -p ${DEPLOY_DIR_IMAGE}/${IMAGEDIR}; \
	cp ${DEPLOY_DIR_IMAGE}/splash.bin ${DEPLOY_DIR_IMAGE}/${IMAGEDIR}/splash.bin; \
	mv ${DEPLOY_DIR_IMAGE}/${IMAGE_NAME}.rootfs.ubi ${DEPLOY_DIR_IMAGE}/${IMAGEDIR}/rootfs.bin; \
	gzip -f -9c ${DEPLOY_DIR_IMAGE}/vmlinux-${MACHINE}.bin > ${DEPLOY_DIR_IMAGE}/${IMAGEDIR}/kernel.bin; \
	echo ${DISTRO_NAME}-${IMAGE_VERSION}-${MACHINE}-${DATE}_usb > ${DEPLOY_DIR_IMAGE}/${IMAGEDIR}/imageversion; \
	echo "rename this file to 'force' to force an update without confirmation" > ${DEPLOY_DIR_IMAGE}/${IMAGEDIR}/noforce; \
	cd ${DEPLOY_DIR_IMAGE}; \
	zip ${DISTRO_NAME}-${DISTRO_VERSION}-${MACHINE}-${DATE}_usb.zip ${IMAGEDIR}/*; \
	rm -rf miraclebox; \
	"
	
```
